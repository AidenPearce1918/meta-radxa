## conf/distro/radxa.conf
```bitbake
# --- File: meta-radxa/conf/distro/radxa.conf ---
# Basic Radxa distribution configuration
DISTRO_NAME = "Radxa Custom Distro"
DISTRO_VERSION = "1.0"
DISTRO_MAINTAINER = "Your Name <you@example.com>"

# Add any distro-specific overrides or variables below
```

## conf/layer.conf
```bitbake
# --- File: meta-radxa/conf/layer.conf ---
BBPATH .= ":${LAYERDIR}"
BBFILES += "${LAYERDIR}/recipes-*/*/*.bb \
            ${LAYERDIR}/recipes-*/*/*.bbappend"

LAYERSERIES_COMPAT_radxa = "scarthgap kirkstone"
```
